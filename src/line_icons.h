// line_icons.h
// MVV-Liniensymbole (S-Bahn, U-Bahn, Tram, Nacht-Tram) als 1-Bit-XBM, 16 px hoch.
// Quelle S/U: Wikimedia Commons (Dateien "Muenchen_S1.svg", "Muenchen_U1.svg"
// usw., dort als gemeinfrei / Public Domain gekennzeichnet), auf 16 px Hoehe
// in 1-Bit konvertiert. Die Liniensymbole koennen Marken der jeweiligen
// Inhaber (MVV, MVG, DB) sein.
// Tram + Nacht-Tram: einheitlich 30x16, schwarzer Kasten, weisse Pixel-Ziffern
// (eigene 6x10-Pixelschrift, N 7x10).
// S-Bahn einheitlich 36x16 (S5 auf 36 px angeglichen).
// WICHTIG: NACH <heltec-eink-modules.h> einbinden (BLACK/WHITE werden benoetigt).
//
// Format: XBM (LSB zuerst), direkt nutzbar mit Adafruit-GFX drawXBitmap():
//   const LineIcon* ic = findLineIcon(departures[i].line);
//   if (ic) display.drawXBitmap(x, yTop, ic->bits, ic->width, LINE_ICON_HEIGHT, BLACK);
//
// Schluessel = "label" aus der MVG-API: "S1", "U3", Tram nur Nummer ("19"),
// Nacht-Tram "N17". Busse haben kein Icon -> drawLineIcon() erzeugt dafuer
// zur Laufzeit einen Rahmen mit der Liniennummer (siehe unten).
// Flash-Bedarf aller Bitmaps: ca. 2960 Bytes.
#pragma once
#include <Arduino.h>

#define LINE_ICON_HEIGHT 16

struct LineIcon {
  const char* label;          // wie von der MVG-API geliefert
  uint8_t width;              // Hoehe immer LINE_ICON_HEIGHT
  const unsigned char* bits;  // XBM-Daten im PROGMEM
};

// S1 (36x16)
static const unsigned char icon_s1_bits[] PROGMEM = {
  0xC0, 0xFF, 0xFF, 0x3F, 0x00, 0xF0, 0xFF, 0xFF, 0xFF, 0x00, 0xF8, 0x01,
  0xFE, 0xF8, 0x01, 0xFC, 0x01, 0x3C, 0xF8, 0x03, 0xFE, 0x38, 0x1C, 0xF8,
  0x07, 0xFE, 0xF8, 0x1F, 0xF8, 0x07, 0xFF, 0xE0, 0xFF, 0xF8, 0x0F, 0xFF,
  0x01, 0xFE, 0xF8, 0x0F, 0xFF, 0x03, 0xFC, 0xF8, 0x0F, 0xFF, 0x3F, 0xFC,
  0xF8, 0x0F, 0xFE, 0x78, 0xFC, 0xF8, 0x07, 0xFE, 0x78, 0xFC, 0xF8, 0x07,
  0xFC, 0x00, 0xFC, 0xF8, 0x03, 0xF8, 0x01, 0xFE, 0xF8, 0x01, 0xF0, 0xFF,
  0xFF, 0xFF, 0x00, 0xC0, 0xFF, 0xFF, 0x3F, 0x00,
};

// S2 (36x16)
static const unsigned char icon_s2_bits[] PROGMEM = {
  0xC0, 0xFF, 0xFF, 0x3F, 0x00, 0xF0, 0xFF, 0xFF, 0xFF, 0x00, 0xF8, 0x01,
  0x1F, 0xF8, 0x01, 0xFC, 0x00, 0x0E, 0xF0, 0x03, 0x7E, 0x38, 0x8E, 0xE1,
  0x07, 0x7E, 0xF8, 0xFF, 0xE3, 0x07, 0x7F, 0xF0, 0xFF, 0xF1, 0x0F, 0xFF,
  0x00, 0xFF, 0xF1, 0x0F, 0xFF, 0x01, 0x7E, 0xF8, 0x0F, 0xFF, 0x1F, 0x3C,
  0xFC, 0x0F, 0x7E, 0x3C, 0x1C, 0xFE, 0x07, 0x7E, 0x38, 0x0C, 0xFF, 0x07,
  0xFC, 0x00, 0x06, 0xE0, 0x03, 0xF8, 0x01, 0x07, 0xE0, 0x01, 0xF0, 0xFF,
  0xFF, 0xFF, 0x00, 0xC0, 0xFF, 0xFF, 0x3F, 0x00,
};

// S3 (36x16)
static const unsigned char icon_s3_bits[] PROGMEM = {
  0xC0, 0xFF, 0xFF, 0x3F, 0x00, 0xF0, 0xFF, 0xFF, 0xFF, 0x00, 0xF8, 0x01,
  0x1F, 0xF8, 0x01, 0xFC, 0x00, 0x0E, 0xF0, 0x03, 0x7E, 0x38, 0x86, 0xE1,
  0x07, 0x7E, 0xF8, 0xFF, 0xE3, 0x07, 0x7F, 0xF0, 0xFF, 0xF1, 0x0F, 0xFF,
  0x00, 0x7F, 0xF8, 0x0F, 0xFF, 0x01, 0x7E, 0xF0, 0x0F, 0xFF, 0x1F, 0xFE,
  0xE1, 0x0F, 0x7E, 0x3C, 0xFC, 0xE3, 0x07, 0x7E, 0x3C, 0xC4, 0xE3, 0x07,
  0xFC, 0x00, 0x06, 0xE0, 0x03, 0xF8, 0x01, 0x0F, 0xF0, 0x01, 0xF0, 0xFF,
  0xFF, 0xFF, 0x00, 0xC0, 0xFF, 0xFF, 0x3F, 0x00,
};

// S4 (36x16)
static const unsigned char icon_s4_bits[] PROGMEM = {
  0xC0, 0xFF, 0xFF, 0x3F, 0x00, 0xF0, 0xFF, 0xFF, 0xFF, 0x00, 0xF8, 0x01,
  0xFF, 0xF8, 0x01, 0xFC, 0x00, 0x7E, 0xF8, 0x03, 0x7E, 0x38, 0x3E, 0xF8,
  0x07, 0x7E, 0xF8, 0x3F, 0xF9, 0x07, 0x7F, 0xF0, 0x9F, 0xF9, 0x0F, 0xFF,
  0x00, 0x8F, 0xF9, 0x0F, 0xFF, 0x01, 0xC6, 0xF9, 0x0F, 0xFF, 0x1F, 0xE6,
  0xF1, 0x0F, 0x7E, 0x3C, 0x04, 0xE0, 0x07, 0x7E, 0x3C, 0x04, 0xE0, 0x07,
  0xFC, 0x00, 0xFE, 0xF9, 0x03, 0xF8, 0x01, 0xFF, 0xF9, 0x01, 0xF0, 0xFF,
  0xFF, 0xFF, 0x00, 0xC0, 0xFF, 0xFF, 0x3F, 0x00,
};

// S5 (36x16)
static const unsigned char icon_s5_bits[] PROGMEM = {
  0xE0, 0xFF, 0xFF, 0x7F, 0x00, 0xF8, 0xFF, 0xFF, 0xFF, 0x00, 0xFC, 0x03,
  0x0F, 0xF8, 0x01, 0xFE, 0x01, 0x06, 0xF8, 0x03, 0xFE, 0x38, 0xC6, 0xFF,
  0x07, 0xFF, 0xF8, 0xC7, 0xFF, 0x07, 0xFF, 0xE0, 0x47, 0xFE, 0x0F, 0xFF,
  0x01, 0x07, 0xF8, 0x0F, 0xFF, 0x03, 0xC6, 0xF0, 0x0F, 0xFF, 0x3F, 0xFE,
  0xF1, 0x0F, 0xFF, 0x78, 0xFE, 0xF1, 0x07, 0xFE, 0x38, 0xC6, 0xF0, 0x07,
  0xFE, 0x01, 0x06, 0xF8, 0x03, 0xFC, 0x83, 0x0F, 0xFC, 0x01, 0xF8, 0xFF,
  0xFF, 0xFF, 0x00, 0xE0, 0xFF, 0xFF, 0x7F, 0x00,
};

// S6 (36x16)
static const unsigned char icon_s6_bits[] PROGMEM = {
  0xC0, 0xFF, 0xFF, 0x3F, 0x00, 0xF0, 0xFF, 0xFF, 0xFF, 0x00, 0xF8, 0x01,
  0x3F, 0xF8, 0x01, 0xFC, 0x00, 0x1E, 0xF0, 0x03, 0x7E, 0x38, 0x8E, 0xF1,
  0x07, 0x7E, 0xF8, 0xCF, 0xFF, 0x07, 0x7F, 0xF0, 0xC7, 0xF8, 0x0F, 0xFF,
  0x00, 0x07, 0xF0, 0x0F, 0xFF, 0x01, 0x86, 0xE3, 0x0F, 0xFF, 0x1F, 0x86,
  0xE3, 0x0F, 0x7E, 0x3C, 0xC4, 0xE3, 0x07, 0x7E, 0x3C, 0x8C, 0xE3, 0x07,
  0xFC, 0x00, 0x0E, 0xF0, 0x03, 0xF8, 0x01, 0x1F, 0xF8, 0x01, 0xF0, 0xFF,
  0xFF, 0xFF, 0x00, 0xC0, 0xFF, 0xFF, 0x3F, 0x00,
};

// S7 (36x16)
static const unsigned char icon_s7_bits[] PROGMEM = {
  0xC0, 0xFF, 0xFF, 0x3F, 0x00, 0xF0, 0xFF, 0xFF, 0xFF, 0x00, 0xF8, 0x01,
  0x0F, 0xF0, 0x01, 0xFC, 0x00, 0x06, 0xF0, 0x03, 0x7E, 0x38, 0x06, 0xF0,
  0x07, 0x7E, 0xF8, 0xFF, 0xF1, 0x07, 0x7F, 0xF0, 0xFF, 0xF1, 0x0F, 0xFF,
  0x00, 0xFF, 0xF8, 0x0F, 0xFF, 0x01, 0xFE, 0xF8, 0x0F, 0xFF, 0x1F, 0x7E,
  0xFC, 0x0F, 0x7E, 0x3C, 0x7C, 0xFC, 0x07, 0x7E, 0x3C, 0x3C, 0xFC, 0x07,
  0xFC, 0x00, 0x1E, 0xFE, 0x03, 0xF8, 0x01, 0x1F, 0xFE, 0x01, 0xF0, 0xFF,
  0xFF, 0xFF, 0x00, 0xC0, 0xFF, 0xFF, 0x3F, 0x00,
};

// S8 (36x16)
static const unsigned char icon_s8_bits[] PROGMEM = {
  0xC0, 0xFF, 0xFF, 0x3F, 0x00, 0xF0, 0xFF, 0xFF, 0xFF, 0x00, 0xF8, 0x01,
  0x1F, 0xF8, 0x01, 0xFC, 0x00, 0x0E, 0xF0, 0x03, 0x7E, 0x38, 0x8E, 0xF3,
  0x07, 0x7E, 0xF8, 0xCF, 0xF3, 0x07, 0x7F, 0xF0, 0x8F, 0xF1, 0x0F, 0xFF,
  0x00, 0x1F, 0xF8, 0x0F, 0xFF, 0x01, 0x1E, 0xF0, 0x0F, 0xFF, 0x1F, 0x8E,
  0xE3, 0x0F, 0x7E, 0x3C, 0xC4, 0xE3, 0x07, 0x7E, 0x3C, 0xC4, 0xE3, 0x07,
  0xFC, 0x00, 0x0E, 0xE0, 0x03, 0xF8, 0x01, 0x0F, 0xF0, 0x01, 0xF0, 0xFF,
  0xFF, 0xFF, 0x00, 0xC0, 0xFF, 0xFF, 0x3F, 0x00,
};

// S20 (36x16)
static const unsigned char icon_s20_bits[] PROGMEM = {
  0xC0, 0xFF, 0xFF, 0x3F, 0x00, 0xF0, 0xFF, 0xFF, 0xFF, 0x00, 0x18, 0xF0,
  0xE0, 0xC3, 0x01, 0x1C, 0x70, 0xC0, 0x81, 0x03, 0x8E, 0x31, 0xC4, 0x98,
  0x07, 0x8E, 0xFF, 0xC7, 0x18, 0x07, 0x0F, 0xFE, 0xC7, 0x1C, 0x0F, 0x1F,
  0xF8, 0xC7, 0x1C, 0x0F, 0x3F, 0xF0, 0xE3, 0x1C, 0x0F, 0xFF, 0xE1, 0xF1,
  0x1C, 0x0F, 0x8E, 0xE3, 0xF8, 0x18, 0x07, 0x8E, 0x23, 0xFC, 0x18, 0x07,
  0x1C, 0x30, 0xC0, 0x81, 0x03, 0x18, 0x30, 0xC0, 0xC1, 0x01, 0xF0, 0xFF,
  0xFF, 0xFF, 0x00, 0xC0, 0xFF, 0xFF, 0x3F, 0x00,
};

// U1 (28x16)
static const unsigned char icon_u1_bits[] PROGMEM = {
  0xFF, 0xFF, 0xFF, 0x0F, 0xFF, 0xFF, 0xFF, 0x0F, 0xFF, 0xFF, 0xFF, 0x0F,
  0x3F, 0xCF, 0xE3, 0x0F, 0x3F, 0xCF, 0xE0, 0x0F, 0x3F, 0xCF, 0xE6, 0x0F,
  0x3F, 0xCF, 0xE7, 0x0F, 0x3F, 0xCF, 0xE7, 0x0F, 0x3F, 0xCF, 0xE7, 0x0F,
  0x3F, 0xCF, 0xE7, 0x0F, 0x3F, 0xC7, 0xE7, 0x0F, 0x3F, 0xE0, 0xC3, 0x0F,
  0x7F, 0xE0, 0x81, 0x0F, 0xFF, 0xFF, 0xFF, 0x0F, 0xFF, 0xFF, 0xFF, 0x0F,
  0xFF, 0xFF, 0xFF, 0x0F,
};

// U2 (28x16)
static const unsigned char icon_u2_bits[] PROGMEM = {
  0xFF, 0xFF, 0xFF, 0x0F, 0xFF, 0xFF, 0xFF, 0x0F, 0xFF, 0xFF, 0xFF, 0x0F,
  0x3F, 0xCF, 0xC0, 0x0F, 0x3F, 0xCF, 0x8F, 0x0F, 0x3F, 0xCF, 0x9F, 0x0F,
  0x3F, 0xCF, 0x8F, 0x0F, 0x3F, 0xCF, 0xC7, 0x0F, 0x3F, 0xCF, 0xE3, 0x0F,
  0x3F, 0xCF, 0xF1, 0x0F, 0x3F, 0xC7, 0xF8, 0x0F, 0x3F, 0xE0, 0xF8, 0x0F,
  0x7F, 0xE0, 0x80, 0x0F, 0xFF, 0xFF, 0xFF, 0x0F, 0xFF, 0xFF, 0xFF, 0x0F,
  0xFF, 0xFF, 0xFF, 0x0F,
};

// U3 (28x16)
static const unsigned char icon_u3_bits[] PROGMEM = {
  0xFF, 0xFF, 0xFF, 0x0F, 0xFF, 0xFF, 0xFF, 0x0F, 0xFF, 0xFF, 0xFF, 0x0F,
  0x3F, 0xCF, 0xC0, 0x0F, 0x3F, 0xCF, 0xCF, 0x0F, 0x3F, 0xCF, 0xCF, 0x0F,
  0x3F, 0xCF, 0xCF, 0x0F, 0x3F, 0xCF, 0xE1, 0x0F, 0x3F, 0xCF, 0xC7, 0x0F,
  0x3F, 0xC7, 0x8F, 0x0F, 0x3F, 0xC7, 0x8F, 0x0F, 0x3F, 0xE0, 0xC7, 0x0F,
  0x7F, 0xE0, 0xC0, 0x0F, 0xFF, 0xFF, 0xFF, 0x0F, 0xFF, 0xFF, 0xFF, 0x0F,
  0xFF, 0xFF, 0xFF, 0x0F,
};

// U4 (28x16)
static const unsigned char icon_u4_bits[] PROGMEM = {
  0xFF, 0xFF, 0xFF, 0x0F, 0xFF, 0xFF, 0xFF, 0x0F, 0xFF, 0xFF, 0xFF, 0x0F,
  0x3F, 0xCF, 0xC7, 0x0F, 0x3F, 0xCF, 0xC3, 0x0F, 0x3F, 0xCF, 0xCB, 0x0F,
  0x3F, 0xCF, 0xC9, 0x0F, 0x3F, 0xCF, 0xCD, 0x0F, 0x3F, 0xCF, 0xCC, 0x0F,
  0x3F, 0xC7, 0x80, 0x0F, 0x3F, 0xC7, 0x87, 0x0F, 0x3F, 0xE0, 0xCF, 0x0F,
  0x7F, 0xE0, 0xCF, 0x0F, 0xFF, 0xFF, 0xFF, 0x0F, 0xFF, 0xFF, 0xFF, 0x0F,
  0xFF, 0xFF, 0xFF, 0x0F,
};

// U5 (28x16)
static const unsigned char icon_u5_bits[] PROGMEM = {
  0xFF, 0xFF, 0xFF, 0x0F, 0xFF, 0xFF, 0xFF, 0x0F, 0xFF, 0xFF, 0xFF, 0x0F,
  0x3F, 0xCF, 0xC1, 0x0F, 0x3F, 0xCF, 0xF9, 0x0F, 0x3F, 0xCF, 0xF9, 0x0F,
  0x3F, 0xCF, 0xF9, 0x0F, 0x3F, 0xCF, 0xC1, 0x0F, 0x3F, 0xCF, 0x8F, 0x0F,
  0x3F, 0xC7, 0x8F, 0x0F, 0x3F, 0xC7, 0x8F, 0x0F, 0x3F, 0xE0, 0xC7, 0x0F,
  0x7F, 0xE0, 0xC0, 0x0F, 0xFF, 0xFF, 0xFF, 0x0F, 0xFF, 0xFF, 0xFF, 0x0F,
  0xFF, 0xFF, 0xFF, 0x0F,
};

// U6 (28x16)
static const unsigned char icon_u6_bits[] PROGMEM = {
  0xFF, 0xFF, 0xFF, 0x0F, 0xFF, 0xFF, 0xFF, 0x0F, 0xFF, 0xFF, 0xEF, 0x0F,
  0x3F, 0xCF, 0xC7, 0x0F, 0x3F, 0xCF, 0xE3, 0x0F, 0x3F, 0xCF, 0xF1, 0x0F,
  0x3F, 0xCF, 0xF9, 0x0F, 0x3F, 0xCF, 0xC0, 0x0F, 0x3F, 0xCF, 0x88, 0x0F,
  0x3F, 0xC7, 0x9C, 0x0F, 0x3F, 0xC7, 0x9C, 0x0F, 0x3F, 0xE0, 0x88, 0x0F,
  0x7F, 0xE0, 0xC1, 0x0F, 0xFF, 0xFF, 0xFF, 0x0F, 0xFF, 0xFF, 0xFF, 0x0F,
  0xFF, 0xFF, 0xFF, 0x0F,
};

// U7 (28x16)
static const unsigned char icon_u7_bits[] PROGMEM = {
  0xFF, 0xFF, 0xFF, 0x0F, 0xFF, 0xFF, 0xFF, 0x0F, 0xFF, 0xFF, 0xFF, 0x0F,
  0x3F, 0xCF, 0x80, 0x0F, 0x3F, 0xCF, 0x8F, 0x0F, 0x3F, 0xCF, 0xCF, 0x0F,
  0x3F, 0xCF, 0xCF, 0x0F, 0x3F, 0xCF, 0xC7, 0x0F, 0x3F, 0xCF, 0xE7, 0x0F,
  0x3F, 0xCF, 0xE3, 0x0F, 0x3F, 0xC7, 0xF3, 0x0F, 0x3F, 0xE0, 0xF1, 0x0F,
  0x7F, 0xE0, 0xF1, 0x0F, 0xFF, 0xFF, 0xFF, 0x0F, 0xFF, 0xFF, 0xFF, 0x0F,
  0xFF, 0xFF, 0xFF, 0x0F,
};

// U8 (28x16)
static const unsigned char icon_u8_bits[] PROGMEM = {
  0xFF, 0xFF, 0xFF, 0x0F, 0xFF, 0xFF, 0xFF, 0x0F, 0xFF, 0xFF, 0xFF, 0x0F,
  0x3F, 0xCF, 0xC1, 0x0F, 0x3F, 0xCF, 0x88, 0x0F, 0x3F, 0xCF, 0x9C, 0x0F,
  0x3F, 0xCF, 0x89, 0x0F, 0x3F, 0xCF, 0xC1, 0x0F, 0x3F, 0xCF, 0x89, 0x0F,
  0x3F, 0xC7, 0x9C, 0x0F, 0x3F, 0xC7, 0x9C, 0x0F, 0x3F, 0xE0, 0x88, 0x0F,
  0x7F, 0xE0, 0xC1, 0x0F, 0xFF, 0xFF, 0xFF, 0x0F, 0xFF, 0xFF, 0xFF, 0x0F,
  0xFF, 0xFF, 0xFF, 0x0F,
};

// Tram12 (30x16)
static const unsigned char icon_tram12_bits[] PROGMEM = {
  0xFF, 0xFF, 0xFF, 0x3F, 0xFF, 0xFF, 0xFF, 0x3F, 0xFF, 0xFF, 0xFF, 0x3F,
  0xFF, 0xF3, 0xE1, 0x3F, 0xFF, 0xF1, 0xCC, 0x3F, 0xFF, 0xF0, 0xCF, 0x3F,
  0xFF, 0xF3, 0xCF, 0x3F, 0xFF, 0xF3, 0xE7, 0x3F, 0xFF, 0xF3, 0xF3, 0x3F,
  0xFF, 0xF3, 0xF9, 0x3F, 0xFF, 0xF3, 0xFC, 0x3F, 0xFF, 0xF3, 0xFC, 0x3F,
  0xFF, 0xC0, 0xC0, 0x3F, 0xFF, 0xFF, 0xFF, 0x3F, 0xFF, 0xFF, 0xFF, 0x3F,
  0xFF, 0xFF, 0xFF, 0x3F,
};

// Tram14 (30x16)
static const unsigned char icon_tram14_bits[] PROGMEM = {
  0xFF, 0xFF, 0xFF, 0x3F, 0xFF, 0xFF, 0xFF, 0x3F, 0xFF, 0xFF, 0xFF, 0x3F,
  0xFF, 0xF3, 0xE7, 0x3F, 0xFF, 0xF1, 0xE3, 0x3F, 0xFF, 0xF0, 0xE1, 0x3F,
  0xFF, 0xF3, 0xE4, 0x3F, 0xFF, 0xF3, 0xE4, 0x3F, 0xFF, 0xF3, 0xC0, 0x3F,
  0xFF, 0xF3, 0xE7, 0x3F, 0xFF, 0xF3, 0xE7, 0x3F, 0xFF, 0xF3, 0xE7, 0x3F,
  0xFF, 0xC0, 0xE7, 0x3F, 0xFF, 0xFF, 0xFF, 0x3F, 0xFF, 0xFF, 0xFF, 0x3F,
  0xFF, 0xFF, 0xFF, 0x3F,
};

// Tram15 (30x16)
static const unsigned char icon_tram15_bits[] PROGMEM = {
  0xFF, 0xFF, 0xFF, 0x3F, 0xFF, 0xFF, 0xFF, 0x3F, 0xFF, 0xFF, 0xFF, 0x3F,
  0xFF, 0xF3, 0xC0, 0x3F, 0xFF, 0xF1, 0xFC, 0x3F, 0xFF, 0xF0, 0xFC, 0x3F,
  0xFF, 0xF3, 0xE0, 0x3F, 0xFF, 0xF3, 0xCF, 0x3F, 0xFF, 0xF3, 0xCF, 0x3F,
  0xFF, 0xF3, 0xCF, 0x3F, 0xFF, 0xF3, 0xCF, 0x3F, 0xFF, 0xF3, 0xCC, 0x3F,
  0xFF, 0xC0, 0xE1, 0x3F, 0xFF, 0xFF, 0xFF, 0x3F, 0xFF, 0xFF, 0xFF, 0x3F,
  0xFF, 0xFF, 0xFF, 0x3F,
};

// Tram16 (30x16)
static const unsigned char icon_tram16_bits[] PROGMEM = {
  0xFF, 0xFF, 0xFF, 0x3F, 0xFF, 0xFF, 0xFF, 0x3F, 0xFF, 0xFF, 0xFF, 0x3F,
  0xFF, 0xF3, 0xE1, 0x3F, 0xFF, 0xF1, 0xCC, 0x3F, 0xFF, 0xF0, 0xFC, 0x3F,
  0xFF, 0xF3, 0xFC, 0x3F, 0xFF, 0xF3, 0xE0, 0x3F, 0xFF, 0xF3, 0xCC, 0x3F,
  0xFF, 0xF3, 0xCC, 0x3F, 0xFF, 0xF3, 0xCC, 0x3F, 0xFF, 0xF3, 0xCC, 0x3F,
  0xFF, 0xC0, 0xE1, 0x3F, 0xFF, 0xFF, 0xFF, 0x3F, 0xFF, 0xFF, 0xFF, 0x3F,
  0xFF, 0xFF, 0xFF, 0x3F,
};

// Tram17 (30x16)
static const unsigned char icon_tram17_bits[] PROGMEM = {
  0xFF, 0xFF, 0xFF, 0x3F, 0xFF, 0xFF, 0xFF, 0x3F, 0xFF, 0xFF, 0xFF, 0x3F,
  0xFF, 0xF3, 0xC0, 0x3F, 0xFF, 0xF1, 0xCF, 0x3F, 0xFF, 0xF0, 0xCF, 0x3F,
  0xFF, 0xF3, 0xE7, 0x3F, 0xFF, 0xF3, 0xE7, 0x3F, 0xFF, 0xF3, 0xF3, 0x3F,
  0xFF, 0xF3, 0xF3, 0x3F, 0xFF, 0xF3, 0xF3, 0x3F, 0xFF, 0xF3, 0xF3, 0x3F,
  0xFF, 0xC0, 0xF3, 0x3F, 0xFF, 0xFF, 0xFF, 0x3F, 0xFF, 0xFF, 0xFF, 0x3F,
  0xFF, 0xFF, 0xFF, 0x3F,
};

// Tram18 (30x16)
static const unsigned char icon_tram18_bits[] PROGMEM = {
  0xFF, 0xFF, 0xFF, 0x3F, 0xFF, 0xFF, 0xFF, 0x3F, 0xFF, 0xFF, 0xFF, 0x3F,
  0xFF, 0xF3, 0xE1, 0x3F, 0xFF, 0xF1, 0xCC, 0x3F, 0xFF, 0xF0, 0xCC, 0x3F,
  0xFF, 0xF3, 0xCC, 0x3F, 0xFF, 0xF3, 0xE1, 0x3F, 0xFF, 0xF3, 0xCC, 0x3F,
  0xFF, 0xF3, 0xCC, 0x3F, 0xFF, 0xF3, 0xCC, 0x3F, 0xFF, 0xF3, 0xCC, 0x3F,
  0xFF, 0xC0, 0xE1, 0x3F, 0xFF, 0xFF, 0xFF, 0x3F, 0xFF, 0xFF, 0xFF, 0x3F,
  0xFF, 0xFF, 0xFF, 0x3F,
};

// Tram19 (30x16)
static const unsigned char icon_tram19_bits[] PROGMEM = {
  0xFF, 0xFF, 0xFF, 0x3F, 0xFF, 0xFF, 0xFF, 0x3F, 0xFF, 0xFF, 0xFF, 0x3F,
  0xFF, 0xF3, 0xE1, 0x3F, 0xFF, 0xF1, 0xCC, 0x3F, 0xFF, 0xF0, 0xCC, 0x3F,
  0xFF, 0xF3, 0xCC, 0x3F, 0xFF, 0xF3, 0xCC, 0x3F, 0xFF, 0xF3, 0xC1, 0x3F,
  0xFF, 0xF3, 0xCF, 0x3F, 0xFF, 0xF3, 0xCF, 0x3F, 0xFF, 0xF3, 0xCC, 0x3F,
  0xFF, 0xC0, 0xE1, 0x3F, 0xFF, 0xFF, 0xFF, 0x3F, 0xFF, 0xFF, 0xFF, 0x3F,
  0xFF, 0xFF, 0xFF, 0x3F,
};

// Tram20 (30x16)
static const unsigned char icon_tram20_bits[] PROGMEM = {
  0xFF, 0xFF, 0xFF, 0x3F, 0xFF, 0xFF, 0xFF, 0x3F, 0xFF, 0xFF, 0xFF, 0x3F,
  0xFF, 0xE1, 0xE1, 0x3F, 0xFF, 0xCC, 0xCC, 0x3F, 0xFF, 0xCF, 0xCC, 0x3F,
  0xFF, 0xCF, 0xCC, 0x3F, 0xFF, 0xE7, 0xCC, 0x3F, 0xFF, 0xF3, 0xCC, 0x3F,
  0xFF, 0xF9, 0xCC, 0x3F, 0xFF, 0xFC, 0xCC, 0x3F, 0xFF, 0xFC, 0xCC, 0x3F,
  0xFF, 0xC0, 0xE1, 0x3F, 0xFF, 0xFF, 0xFF, 0x3F, 0xFF, 0xFF, 0xFF, 0x3F,
  0xFF, 0xFF, 0xFF, 0x3F,
};

// Tram21 (30x16)
static const unsigned char icon_tram21_bits[] PROGMEM = {
  0xFF, 0xFF, 0xFF, 0x3F, 0xFF, 0xFF, 0xFF, 0x3F, 0xFF, 0xFF, 0xFF, 0x3F,
  0xFF, 0xE1, 0xF3, 0x3F, 0xFF, 0xCC, 0xF1, 0x3F, 0xFF, 0xCF, 0xF0, 0x3F,
  0xFF, 0xCF, 0xF3, 0x3F, 0xFF, 0xE7, 0xF3, 0x3F, 0xFF, 0xF3, 0xF3, 0x3F,
  0xFF, 0xF9, 0xF3, 0x3F, 0xFF, 0xFC, 0xF3, 0x3F, 0xFF, 0xFC, 0xF3, 0x3F,
  0xFF, 0xC0, 0xC0, 0x3F, 0xFF, 0xFF, 0xFF, 0x3F, 0xFF, 0xFF, 0xFF, 0x3F,
  0xFF, 0xFF, 0xFF, 0x3F,
};

// Tram22 (30x16)
static const unsigned char icon_tram22_bits[] PROGMEM = {
  0xFF, 0xFF, 0xFF, 0x3F, 0xFF, 0xFF, 0xFF, 0x3F, 0xFF, 0xFF, 0xFF, 0x3F,
  0xFF, 0xE1, 0xE1, 0x3F, 0xFF, 0xCC, 0xCC, 0x3F, 0xFF, 0xCF, 0xCF, 0x3F,
  0xFF, 0xCF, 0xCF, 0x3F, 0xFF, 0xE7, 0xE7, 0x3F, 0xFF, 0xF3, 0xF3, 0x3F,
  0xFF, 0xF9, 0xF9, 0x3F, 0xFF, 0xFC, 0xFC, 0x3F, 0xFF, 0xFC, 0xFC, 0x3F,
  0xFF, 0xC0, 0xC0, 0x3F, 0xFF, 0xFF, 0xFF, 0x3F, 0xFF, 0xFF, 0xFF, 0x3F,
  0xFF, 0xFF, 0xFF, 0x3F,
};

// Tram23 (30x16)
static const unsigned char icon_tram23_bits[] PROGMEM = {
  0xFF, 0xFF, 0xFF, 0x3F, 0xFF, 0xFF, 0xFF, 0x3F, 0xFF, 0xFF, 0xFF, 0x3F,
  0xFF, 0xE1, 0xE1, 0x3F, 0xFF, 0xCC, 0xCC, 0x3F, 0xFF, 0xCF, 0xCF, 0x3F,
  0xFF, 0xCF, 0xCF, 0x3F, 0xFF, 0xE7, 0xE3, 0x3F, 0xFF, 0xF3, 0xCF, 0x3F,
  0xFF, 0xF9, 0xCF, 0x3F, 0xFF, 0xFC, 0xCF, 0x3F, 0xFF, 0xFC, 0xCC, 0x3F,
  0xFF, 0xC0, 0xE1, 0x3F, 0xFF, 0xFF, 0xFF, 0x3F, 0xFF, 0xFF, 0xFF, 0x3F,
  0xFF, 0xFF, 0xFF, 0x3F,
};

// Tram24 (30x16)
static const unsigned char icon_tram24_bits[] PROGMEM = {
  0xFF, 0xFF, 0xFF, 0x3F, 0xFF, 0xFF, 0xFF, 0x3F, 0xFF, 0xFF, 0xFF, 0x3F,
  0xFF, 0xE1, 0xE7, 0x3F, 0xFF, 0xCC, 0xE3, 0x3F, 0xFF, 0xCF, 0xE1, 0x3F,
  0xFF, 0xCF, 0xE4, 0x3F, 0xFF, 0xE7, 0xE4, 0x3F, 0xFF, 0xF3, 0xC0, 0x3F,
  0xFF, 0xF9, 0xE7, 0x3F, 0xFF, 0xFC, 0xE7, 0x3F, 0xFF, 0xFC, 0xE7, 0x3F,
  0xFF, 0xC0, 0xE7, 0x3F, 0xFF, 0xFF, 0xFF, 0x3F, 0xFF, 0xFF, 0xFF, 0x3F,
  0xFF, 0xFF, 0xFF, 0x3F,
};

// Tram25 (30x16)
static const unsigned char icon_tram25_bits[] PROGMEM = {
  0xFF, 0xFF, 0xFF, 0x3F, 0xFF, 0xFF, 0xFF, 0x3F, 0xFF, 0xFF, 0xFF, 0x3F,
  0xFF, 0xE1, 0xC0, 0x3F, 0xFF, 0xCC, 0xFC, 0x3F, 0xFF, 0xCF, 0xFC, 0x3F,
  0xFF, 0xCF, 0xE0, 0x3F, 0xFF, 0xE7, 0xCF, 0x3F, 0xFF, 0xF3, 0xCF, 0x3F,
  0xFF, 0xF9, 0xCF, 0x3F, 0xFF, 0xFC, 0xCF, 0x3F, 0xFF, 0xFC, 0xCC, 0x3F,
  0xFF, 0xC0, 0xE1, 0x3F, 0xFF, 0xFF, 0xFF, 0x3F, 0xFF, 0xFF, 0xFF, 0x3F,
  0xFF, 0xFF, 0xFF, 0x3F,
};

// Tram26 (30x16)
static const unsigned char icon_tram26_bits[] PROGMEM = {
  0xFF, 0xFF, 0xFF, 0x3F, 0xFF, 0xFF, 0xFF, 0x3F, 0xFF, 0xFF, 0xFF, 0x3F,
  0xFF, 0xE1, 0xE1, 0x3F, 0xFF, 0xCC, 0xCC, 0x3F, 0xFF, 0xCF, 0xFC, 0x3F,
  0xFF, 0xCF, 0xFC, 0x3F, 0xFF, 0xE7, 0xE0, 0x3F, 0xFF, 0xF3, 0xCC, 0x3F,
  0xFF, 0xF9, 0xCC, 0x3F, 0xFF, 0xFC, 0xCC, 0x3F, 0xFF, 0xFC, 0xCC, 0x3F,
  0xFF, 0xC0, 0xE1, 0x3F, 0xFF, 0xFF, 0xFF, 0x3F, 0xFF, 0xFF, 0xFF, 0x3F,
  0xFF, 0xFF, 0xFF, 0x3F,
};

// Tram27 (30x16)
static const unsigned char icon_tram27_bits[] PROGMEM = {
  0xFF, 0xFF, 0xFF, 0x3F, 0xFF, 0xFF, 0xFF, 0x3F, 0xFF, 0xFF, 0xFF, 0x3F,
  0xFF, 0xE1, 0xC0, 0x3F, 0xFF, 0xCC, 0xCF, 0x3F, 0xFF, 0xCF, 0xCF, 0x3F,
  0xFF, 0xCF, 0xE7, 0x3F, 0xFF, 0xE7, 0xE7, 0x3F, 0xFF, 0xF3, 0xF3, 0x3F,
  0xFF, 0xF9, 0xF3, 0x3F, 0xFF, 0xFC, 0xF3, 0x3F, 0xFF, 0xFC, 0xF3, 0x3F,
  0xFF, 0xC0, 0xF3, 0x3F, 0xFF, 0xFF, 0xFF, 0x3F, 0xFF, 0xFF, 0xFF, 0x3F,
  0xFF, 0xFF, 0xFF, 0x3F,
};

// Tram28 (30x16)
static const unsigned char icon_tram28_bits[] PROGMEM = {
  0xFF, 0xFF, 0xFF, 0x3F, 0xFF, 0xFF, 0xFF, 0x3F, 0xFF, 0xFF, 0xFF, 0x3F,
  0xFF, 0xE1, 0xE1, 0x3F, 0xFF, 0xCC, 0xCC, 0x3F, 0xFF, 0xCF, 0xCC, 0x3F,
  0xFF, 0xCF, 0xCC, 0x3F, 0xFF, 0xE7, 0xE1, 0x3F, 0xFF, 0xF3, 0xCC, 0x3F,
  0xFF, 0xF9, 0xCC, 0x3F, 0xFF, 0xFC, 0xCC, 0x3F, 0xFF, 0xFC, 0xCC, 0x3F,
  0xFF, 0xC0, 0xE1, 0x3F, 0xFF, 0xFF, 0xFF, 0x3F, 0xFF, 0xFF, 0xFF, 0x3F,
  0xFF, 0xFF, 0xFF, 0x3F,
};

// Tram29 (30x16)
static const unsigned char icon_tram29_bits[] PROGMEM = {
  0xFF, 0xFF, 0xFF, 0x3F, 0xFF, 0xFF, 0xFF, 0x3F, 0xFF, 0xFF, 0xFF, 0x3F,
  0xFF, 0xE1, 0xE1, 0x3F, 0xFF, 0xCC, 0xCC, 0x3F, 0xFF, 0xCF, 0xCC, 0x3F,
  0xFF, 0xCF, 0xCC, 0x3F, 0xFF, 0xE7, 0xCC, 0x3F, 0xFF, 0xF3, 0xC1, 0x3F,
  0xFF, 0xF9, 0xCF, 0x3F, 0xFF, 0xFC, 0xCF, 0x3F, 0xFF, 0xFC, 0xCC, 0x3F,
  0xFF, 0xC0, 0xE1, 0x3F, 0xFF, 0xFF, 0xFF, 0x3F, 0xFF, 0xFF, 0xFF, 0x3F,
  0xFF, 0xFF, 0xFF, 0x3F,
};

// Tram37 (30x16)
static const unsigned char icon_tram37_bits[] PROGMEM = {
  0xFF, 0xFF, 0xFF, 0x3F, 0xFF, 0xFF, 0xFF, 0x3F, 0xFF, 0xFF, 0xFF, 0x3F,
  0xFF, 0xE1, 0xC0, 0x3F, 0xFF, 0xCC, 0xCF, 0x3F, 0xFF, 0xCF, 0xCF, 0x3F,
  0xFF, 0xCF, 0xE7, 0x3F, 0xFF, 0xE3, 0xE7, 0x3F, 0xFF, 0xCF, 0xF3, 0x3F,
  0xFF, 0xCF, 0xF3, 0x3F, 0xFF, 0xCF, 0xF3, 0x3F, 0xFF, 0xCC, 0xF3, 0x3F,
  0xFF, 0xE1, 0xF3, 0x3F, 0xFF, 0xFF, 0xFF, 0x3F, 0xFF, 0xFF, 0xFF, 0x3F,
  0xFF, 0xFF, 0xFF, 0x3F,
};

// N15 (30x16)
static const unsigned char icon_n15_bits[] PROGMEM = {
  0xFF, 0xFF, 0xFF, 0x3F, 0xFF, 0xFF, 0xFF, 0x3F, 0xFF, 0xFF, 0xFF, 0x3F,
  0xE7, 0x3C, 0x0F, 0x3C, 0xC7, 0x1C, 0xCF, 0x3F, 0xC7, 0x0C, 0xCF, 0x3F,
  0x87, 0x3C, 0x0F, 0x3E, 0x27, 0x3C, 0xFF, 0x3C, 0x27, 0x3C, 0xFF, 0x3C,
  0x67, 0x3C, 0xFF, 0x3C, 0x67, 0x3C, 0xFF, 0x3C, 0xE7, 0x3C, 0xCF, 0x3C,
  0xE7, 0x0C, 0x1C, 0x3E, 0xFF, 0xFF, 0xFF, 0x3F, 0xFF, 0xFF, 0xFF, 0x3F,
  0xFF, 0xFF, 0xFF, 0x3F,
};

// N16 (30x16)
static const unsigned char icon_n16_bits[] PROGMEM = {
  0xFF, 0xFF, 0xFF, 0x3F, 0xFF, 0xFF, 0xFF, 0x3F, 0xFF, 0xFF, 0xFF, 0x3F,
  0xE7, 0x3C, 0x1F, 0x3E, 0xC7, 0x1C, 0xCF, 0x3C, 0xC7, 0x0C, 0xCF, 0x3F,
  0x87, 0x3C, 0xCF, 0x3F, 0x27, 0x3C, 0x0F, 0x3E, 0x27, 0x3C, 0xCF, 0x3C,
  0x67, 0x3C, 0xCF, 0x3C, 0x67, 0x3C, 0xCF, 0x3C, 0xE7, 0x3C, 0xCF, 0x3C,
  0xE7, 0x0C, 0x1C, 0x3E, 0xFF, 0xFF, 0xFF, 0x3F, 0xFF, 0xFF, 0xFF, 0x3F,
  0xFF, 0xFF, 0xFF, 0x3F,
};

// N17 (30x16)
static const unsigned char icon_n17_bits[] PROGMEM = {
  0xFF, 0xFF, 0xFF, 0x3F, 0xFF, 0xFF, 0xFF, 0x3F, 0xFF, 0xFF, 0xFF, 0x3F,
  0xE7, 0x3C, 0x0F, 0x3C, 0xC7, 0x1C, 0xFF, 0x3C, 0xC7, 0x0C, 0xFF, 0x3C,
  0x87, 0x3C, 0x7F, 0x3E, 0x27, 0x3C, 0x7F, 0x3E, 0x27, 0x3C, 0x3F, 0x3F,
  0x67, 0x3C, 0x3F, 0x3F, 0x67, 0x3C, 0x3F, 0x3F, 0xE7, 0x3C, 0x3F, 0x3F,
  0xE7, 0x0C, 0x3C, 0x3F, 0xFF, 0xFF, 0xFF, 0x3F, 0xFF, 0xFF, 0xFF, 0x3F,
  0xFF, 0xFF, 0xFF, 0x3F,
};

// N18 (30x16)
static const unsigned char icon_n18_bits[] PROGMEM = {
  0xFF, 0xFF, 0xFF, 0x3F, 0xFF, 0xFF, 0xFF, 0x3F, 0xFF, 0xFF, 0xFF, 0x3F,
  0xE7, 0x3C, 0x1F, 0x3E, 0xC7, 0x1C, 0xCF, 0x3C, 0xC7, 0x0C, 0xCF, 0x3C,
  0x87, 0x3C, 0xCF, 0x3C, 0x27, 0x3C, 0x1F, 0x3E, 0x27, 0x3C, 0xCF, 0x3C,
  0x67, 0x3C, 0xCF, 0x3C, 0x67, 0x3C, 0xCF, 0x3C, 0xE7, 0x3C, 0xCF, 0x3C,
  0xE7, 0x0C, 0x1C, 0x3E, 0xFF, 0xFF, 0xFF, 0x3F, 0xFF, 0xFF, 0xFF, 0x3F,
  0xFF, 0xFF, 0xFF, 0x3F,
};

// N19 (30x16)
static const unsigned char icon_n19_bits[] PROGMEM = {
  0xFF, 0xFF, 0xFF, 0x3F, 0xFF, 0xFF, 0xFF, 0x3F, 0xFF, 0xFF, 0xFF, 0x3F,
  0xE7, 0x3C, 0x1F, 0x3E, 0xC7, 0x1C, 0xCF, 0x3C, 0xC7, 0x0C, 0xCF, 0x3C,
  0x87, 0x3C, 0xCF, 0x3C, 0x27, 0x3C, 0xCF, 0x3C, 0x27, 0x3C, 0x1F, 0x3C,
  0x67, 0x3C, 0xFF, 0x3C, 0x67, 0x3C, 0xFF, 0x3C, 0xE7, 0x3C, 0xCF, 0x3C,
  0xE7, 0x0C, 0x1C, 0x3E, 0xFF, 0xFF, 0xFF, 0x3F, 0xFF, 0xFF, 0xFF, 0x3F,
  0xFF, 0xFF, 0xFF, 0x3F,
};

// N20 (30x16)
static const unsigned char icon_n20_bits[] PROGMEM = {
  0xFF, 0xFF, 0xFF, 0x3F, 0xFF, 0xFF, 0xFF, 0x3F, 0xFF, 0xFF, 0xFF, 0x3F,
  0xE7, 0x1C, 0x1E, 0x3E, 0xC7, 0xCC, 0xCC, 0x3C, 0xC7, 0xFC, 0xCC, 0x3C,
  0x87, 0xFC, 0xCC, 0x3C, 0x27, 0x7C, 0xCE, 0x3C, 0x27, 0x3C, 0xCF, 0x3C,
  0x67, 0x9C, 0xCF, 0x3C, 0x67, 0xCC, 0xCF, 0x3C, 0xE7, 0xCC, 0xCF, 0x3C,
  0xE7, 0x0C, 0x1C, 0x3E, 0xFF, 0xFF, 0xFF, 0x3F, 0xFF, 0xFF, 0xFF, 0x3F,
  0xFF, 0xFF, 0xFF, 0x3F,
};

// N21 (30x16)
static const unsigned char icon_n21_bits[] PROGMEM = {
  0xFF, 0xFF, 0xFF, 0x3F, 0xFF, 0xFF, 0xFF, 0x3F, 0xFF, 0xFF, 0xFF, 0x3F,
  0xE7, 0x1C, 0x3E, 0x3F, 0xC7, 0xCC, 0x1C, 0x3F, 0xC7, 0xFC, 0x0C, 0x3F,
  0x87, 0xFC, 0x3C, 0x3F, 0x27, 0x7C, 0x3E, 0x3F, 0x27, 0x3C, 0x3F, 0x3F,
  0x67, 0x9C, 0x3F, 0x3F, 0x67, 0xCC, 0x3F, 0x3F, 0xE7, 0xCC, 0x3F, 0x3F,
  0xE7, 0x0C, 0x0C, 0x3C, 0xFF, 0xFF, 0xFF, 0x3F, 0xFF, 0xFF, 0xFF, 0x3F,
  0xFF, 0xFF, 0xFF, 0x3F,
};

// N27 (30x16)
static const unsigned char icon_n27_bits[] PROGMEM = {
  0xFF, 0xFF, 0xFF, 0x3F, 0xFF, 0xFF, 0xFF, 0x3F, 0xFF, 0xFF, 0xFF, 0x3F,
  0xE7, 0x1C, 0x0E, 0x3C, 0xC7, 0xCC, 0xFC, 0x3C, 0xC7, 0xFC, 0xFC, 0x3C,
  0x87, 0xFC, 0x7C, 0x3E, 0x27, 0x7C, 0x7E, 0x3E, 0x27, 0x3C, 0x3F, 0x3F,
  0x67, 0x9C, 0x3F, 0x3F, 0x67, 0xCC, 0x3F, 0x3F, 0xE7, 0xCC, 0x3F, 0x3F,
  0xE7, 0x0C, 0x3C, 0x3F, 0xFF, 0xFF, 0xFF, 0x3F, 0xFF, 0xFF, 0xFF, 0x3F,
  0xFF, 0xFF, 0xFF, 0x3F,
};

// N37 (30x16)
static const unsigned char icon_n37_bits[] PROGMEM = {
  0xFF, 0xFF, 0xFF, 0x3F, 0xFF, 0xFF, 0xFF, 0x3F, 0xFF, 0xFF, 0xFF, 0x3F,
  0xE7, 0x1C, 0x0E, 0x3C, 0xC7, 0xCC, 0xFC, 0x3C, 0xC7, 0xFC, 0xFC, 0x3C,
  0x87, 0xFC, 0x7C, 0x3E, 0x27, 0x3C, 0x7E, 0x3E, 0x27, 0xFC, 0x3C, 0x3F,
  0x67, 0xFC, 0x3C, 0x3F, 0x67, 0xFC, 0x3C, 0x3F, 0xE7, 0xCC, 0x3C, 0x3F,
  0xE7, 0x1C, 0x3E, 0x3F, 0xFF, 0xFF, 0xFF, 0x3F, 0xFF, 0xFF, 0xFF, 0x3F,
  0xFF, 0xFF, 0xFF, 0x3F,
};

static const LineIcon LINE_ICONS[] = {
  { "S1",  36, icon_s1_bits },
  { "S2",  36, icon_s2_bits },
  { "S3",  36, icon_s3_bits },
  { "S4",  36, icon_s4_bits },
  { "S5",  36, icon_s5_bits },
  { "S6",  36, icon_s6_bits },
  { "S7",  36, icon_s7_bits },
  { "S8",  36, icon_s8_bits },
  { "S20", 36, icon_s20_bits },
  { "U1",  28, icon_u1_bits },
  { "U2",  28, icon_u2_bits },
  { "U3",  28, icon_u3_bits },
  { "U4",  28, icon_u4_bits },
  { "U5",  28, icon_u5_bits },
  { "U6",  28, icon_u6_bits },
  { "U7",  28, icon_u7_bits },
  { "U8",  28, icon_u8_bits },
  { "12",  30, icon_tram12_bits },
  { "14",  30, icon_tram14_bits },
  { "15",  30, icon_tram15_bits },
  { "16",  30, icon_tram16_bits },
  { "17",  30, icon_tram17_bits },
  { "18",  30, icon_tram18_bits },
  { "19",  30, icon_tram19_bits },
  { "20",  30, icon_tram20_bits },
  { "21",  30, icon_tram21_bits },
  { "22",  30, icon_tram22_bits },
  { "23",  30, icon_tram23_bits },
  { "24",  30, icon_tram24_bits },
  { "25",  30, icon_tram25_bits },
  { "26",  30, icon_tram26_bits },
  { "27",  30, icon_tram27_bits },
  { "28",  30, icon_tram28_bits },
  { "29",  30, icon_tram29_bits },
  { "37",  30, icon_tram37_bits },
  { "N15", 30, icon_n15_bits },
  { "N16", 30, icon_n16_bits },
  { "N17", 30, icon_n17_bits },
  { "N18", 30, icon_n18_bits },
  { "N19", 30, icon_n19_bits },
  { "N20", 30, icon_n20_bits },
  { "N21", 30, icon_n21_bits },
  { "N27", 30, icon_n27_bits },
  { "N37", 30, icon_n37_bits },
};
static const uint8_t LINE_ICON_COUNT = sizeof(LINE_ICONS) / sizeof(LINE_ICONS[0]);

// Sucht das Icon zu einem Linien-Label. Rueckgabe nullptr, wenn keins existiert.
inline const LineIcon* findLineIcon(const String& label) {
  for (uint8_t i = 0; i < LINE_ICON_COUNT; i++) {
    if (label == LINE_ICONS[i].label) return &LINE_ICONS[i];
  }
  return nullptr;
}

// ============================================================
// Generierte Bus-Icons: Rahmen + Liniennummer in derselben Pixelschrift
// wie die Tram-Icons (Ziffern 6x10 aus den Tram-Icons, "N" 7x10 aus den
// Nacht-Tram-Icons, "X", "R", "B", "E" 6x10 ergaenzt; 2 px Zeichenabstand).
// Auch fuer Regionalzuege ("RB56": 34 px mit 1-px-Rahmen).
// ============================================================

#define LINE_ICON_MAX_WIDTH 36   // breitestes Icon (S-Bahn) - mehr passt nicht vor die Zielspalte
#define BUS_ICON_MIN_WIDTH 30    // kurze Busnummern so breit wie Tram-Icons
#define BUS_GLYPH_HEIGHT 10
#define BUS_GLYPH_TOP 3          // Abstand Oberkante Icon -> Oberkante Zeichen
#define BUS_GLYPH_GAP 2          // Abstand zwischen zwei Zeichen

// Eine Zeile pro Glyphe, Bit 0 = linke Spalte
struct BusGlyph {
  char ch;
  uint8_t width;
  uint8_t rows[BUS_GLYPH_HEIGHT];
};

static const BusGlyph BUS_GLYPHS[] = {
  { '0', 6, { 0x1E, 0x33, 0x33, 0x33, 0x33, 0x33, 0x33, 0x33, 0x33, 0x1E } },
  { '1', 6, { 0x0C, 0x0E, 0x0F, 0x0C, 0x0C, 0x0C, 0x0C, 0x0C, 0x0C, 0x3F } },
  { '2', 6, { 0x1E, 0x33, 0x30, 0x30, 0x18, 0x0C, 0x06, 0x03, 0x03, 0x3F } },
  { '3', 6, { 0x1E, 0x33, 0x30, 0x30, 0x1C, 0x30, 0x30, 0x30, 0x33, 0x1E } },
  { '4', 6, { 0x18, 0x1C, 0x1E, 0x1B, 0x1B, 0x3F, 0x18, 0x18, 0x18, 0x18 } },
  { '5', 6, { 0x3F, 0x03, 0x03, 0x1F, 0x30, 0x30, 0x30, 0x30, 0x33, 0x1E } },
  { '6', 6, { 0x1E, 0x33, 0x03, 0x03, 0x1F, 0x33, 0x33, 0x33, 0x33, 0x1E } },
  { '7', 6, { 0x3F, 0x30, 0x30, 0x18, 0x18, 0x0C, 0x0C, 0x0C, 0x0C, 0x0C } },
  { '8', 6, { 0x1E, 0x33, 0x33, 0x33, 0x1E, 0x33, 0x33, 0x33, 0x33, 0x1E } },
  { '9', 6, { 0x1E, 0x33, 0x33, 0x33, 0x33, 0x3E, 0x30, 0x30, 0x33, 0x1E } },
  { 'N', 7, { 0x63, 0x67, 0x67, 0x6F, 0x7B, 0x7B, 0x73, 0x73, 0x63, 0x63 } },
  { 'X', 6, { 0x33, 0x33, 0x1E, 0x1E, 0x0C, 0x0C, 0x1E, 0x1E, 0x33, 0x33 } },
  // Regionalzuege ("RB56", "RE5")
  { 'R', 6, { 0x1F, 0x33, 0x33, 0x33, 0x1F, 0x0F, 0x1B, 0x1B, 0x33, 0x33 } },
  { 'B', 6, { 0x1F, 0x33, 0x33, 0x33, 0x1F, 0x33, 0x33, 0x33, 0x33, 0x1F } },
  { 'E', 6, { 0x3F, 0x03, 0x03, 0x03, 0x1F, 0x03, 0x03, 0x03, 0x03, 0x3F } },
  // Schienenersatzverkehr ("SEV", zusammen mit 'E')
  { 'S', 6, { 0x1E, 0x33, 0x03, 0x03, 0x1E, 0x30, 0x30, 0x30, 0x33, 0x1E } },
  { 'V', 6, { 0x33, 0x33, 0x33, 0x33, 0x33, 0x33, 0x1E, 0x1E, 0x0C, 0x0C } },
};
static const uint8_t BUS_GLYPH_COUNT = sizeof(BUS_GLYPHS) / sizeof(BUS_GLYPHS[0]);

inline const BusGlyph* findBusGlyph(char ch) {
  for (uint8_t i = 0; i < BUS_GLYPH_COUNT; i++) {
    if (BUS_GLYPHS[i].ch == ch) return &BUS_GLYPHS[i];
  }
  return nullptr;
}

// Breite eines Labels in der Pixelschrift, -1 wenn ein Zeichen fehlt
inline int busTextWidth(const String& label) {
  int w = 0;
  for (unsigned int i = 0; i < label.length(); i++) {
    const BusGlyph* g = findBusGlyph(label[i]);
    if (g == nullptr) return -1;
    w += g->width;
    if (i > 0) w += BUS_GLYPH_GAP;
  }
  return w;
}

// Zeichnet ein Bus-Icon (Rahmen + Nummer) mit Oberkante bei yTop und gibt
// die Breite zurueck. Rahmen 2 px, bei langen Nummern 1 px, Breite zwischen
// BUS_ICON_MIN_WIDTH und LINE_ICON_MAX_WIDTH. Enthaelt das Label Zeichen
// ohne Glyphe oder ist es zu lang, wird die eingebaute 6x8-Schrift von
// Adafruit-GFX verwendet (ggf. gekuerzt). ACHTUNG: Der Fallback setzt die
// Schrift zurueck - Aufrufer muss danach seine Schrift neu setzen.
template <typename GFX>
int drawBusIcon(GFX& d, int x, int yTop, const String& label) {
  int textW = busTextWidth(label);
  int border = 2;
  int pad = 2;
  if (textW >= 0 && textW + 2 * (border + pad) > LINE_ICON_MAX_WIDTH) {
    border = 1;
    pad = 1;
  }

  if (textW >= 0 && textW + 2 * (border + pad) <= LINE_ICON_MAX_WIDTH) {
    int w = textW + 2 * (border + pad);
    if (w < BUS_ICON_MIN_WIDTH) w = BUS_ICON_MIN_WIDTH;

    for (int i = 0; i < border; i++) {
      d.drawRect(x + i, yTop + i, w - 2 * i, LINE_ICON_HEIGHT - 2 * i, BLACK);
    }

    int cx = x + (w - textW) / 2;
    for (unsigned int i = 0; i < label.length(); i++) {
      const BusGlyph* g = findBusGlyph(label[i]);
      for (int r = 0; r < BUS_GLYPH_HEIGHT; r++) {
        for (int c = 0; c < g->width; c++) {
          if (g->rows[r] & (1 << c)) {
            d.drawPixel(cx + c, yTop + BUS_GLYPH_TOP + r, BLACK);
          }
        }
      }
      cx += g->width + BUS_GLYPH_GAP;
    }
    return w;
  }

  // Fallback: eingebaute GFX-Schrift (6 px pro Zeichen inkl. Abstand, 8 px hoch)
  const int maxChars = (LINE_ICON_MAX_WIDTH - 4) / 6;
  String text = label;
  if ((int)text.length() > maxChars) text = text.substring(0, maxChars);
  int w = text.length() * 6 + 3;
  if (w < BUS_ICON_MIN_WIDTH) w = BUS_ICON_MIN_WIDTH;
  d.drawRect(x, yTop, w, LINE_ICON_HEIGHT, BLACK);
  d.setFont(NULL);
  d.setTextSize(1);
  d.setTextColor(BLACK);
  d.setCursor(x + (w - (int)text.length() * 6 + 1) / 2, yTop + 4);
  d.print(text);
  return w;
}

// Zeichnet das passende Liniensymbol mit Oberkante bei yTop und gibt die
// Breite zurueck (max. LINE_ICON_MAX_WIDTH):
// - isBus = true (laut API ein Bus): immer generiertes Bus-Icon, auch wenn
//   es eine Tram mit gleicher Nummer gibt
// - sonst: Bitmap aus LINE_ICONS, falls vorhanden
// - unbekannte Linien (z.B. Regionalzuege "RB56"): ebenfalls Rahmen mit Text
// Funktioniert mit jedem Adafruit-GFX-kompatiblen Display-Objekt.
template <typename GFX>
int drawLineIcon(GFX& d, int x, int yTop, const String& label, bool isBus) {
  if (!isBus) {
    const LineIcon* ic = findLineIcon(label);
    if (ic) {
      d.drawXBitmap(x, yTop, ic->bits, ic->width, LINE_ICON_HEIGHT, BLACK);
      return ic->width;
    }
  }
  return drawBusIcon(d, x, yTop, label);
}
